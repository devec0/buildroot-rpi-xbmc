## package/gstreamer/gst-python/Config.in
```kconfig
config BR2_PACKAGE_GST_PYTHON
	bool "gst-python"
	select BR2_PACKAGE_GST_PLUGINS_BASE
	depends on BR2_LARGEFILE
	depends on BR2_INET_IPV6
	depends on BR2_PACKAGE_PYTHON
	help
	  GStreamer Python bindings.

	  http://gstreamer.freedesktop.org/
```

## package/python-appdirs/Config.in
```kconfig
config BR2_PACKAGE_PYTHON_APPDIRS
	bool "python-appdirs"
	depends on BR2_PACKAGE_PYTHON
	help
		A small Python module for determining appropriate platform-specific dirs.
```

## package/python-decorator/Config.in
```kconfig
config BR2_PACKAGE_PYTHON_DECORATOR
	bool "python-decorator"
	depends on BR2_PACKAGE_PYTHON
	help
		Decorator module.
```

## package/python-gmusicapi/Config.in
```kconfig
config BR2_PACKAGE_PYTHON_GMUSICAPI
	bool "python-gmusicapi"
	depends on BR2_PACKAGE_PYTHON
	depends on BR2_PACKAGE_PYTHON_DATEUTIL
	depends on BR2_PACKAGE_PYTHON_VALIDICTORY
	depends on BR2_PACKAGE_PYTHON_DECORATOR
	depends on BR2_PACKAGE_PYTHON_MUTAGEN
	depends on BR2_PACKAGE_PYTHON_PROTOBUF
	depends on BR2_PACKAGE_PYTHON_REQUESTS
	depends on BR2_PACKAGE_PYTHON_PROBOSCIS
	depends on BR2_PACKAGE_PYTHON_OAUTH2CLIENT
	depends on BR2_PACKAGE_PYTHON_MOCK
	depends on BR2_PACKAGE_PYTHON_APPDIRS
	depends on BR2_PACKAGE_FFMPEG_FFMPEG
	depends on BR2_PACKAGE_PYTHON_HTTPLIB2
	depends on BR2_PACKAGE_PYTHON_SIX
	help
		An unofficial api for Google Play Music.
```

## package/python-httplib2/Config.in
```kconfig
config BR2_PACKAGE_PYTHON_HTTPLIB2
	bool "python-httplib2"
	depends on BR2_PACKAGE_PYTHON
	help
		httplib2
```

## package/python-mock/Config.in
```kconfig
config BR2_PACKAGE_PYTHON_MOCK
	bool "python-mock"
	depends on BR2_PACKAGE_PYTHON
	help
		Mock
```

## package/python-mopidy-alsamixer/Config.in
```kconfig
config BR2_PACKAGE_PYTHON_MOPIDY_ALSAMIXER
	bool "python-mopidy-alsa"
	depends on BR2_PACKAGE_PYTHON
	depends on BR2_PACKAGE_PYTHON_MOPIDY
	depends on BR2_PACKAGE_PYTHON_PYALSAAUDIO
	depends on BR2_PACKAGE_PYTHON_PYKKA
	help
		Mopidy extension for ALSA volume control
```

## package/python-mopidy-gmusic/Config.in
```kconfig
config BR2_PACKAGE_PYTHON_MOPIDY_GMUSIC
	bool "python-mopidy-gmusic"
	depends on BR2_PACKAGE_PYTHON
	depends on BR2_PACKAGE_PYTHON_MOPIDY
	depends on BR2_PACKAGE_PYTHON_GMUSICAPI
	depends on BR2_PACKAGE_PYTHON_APPDIRS
	help
		A mopidy extension to allow streaming from Google Play Music
```

## package/python-mopidy-moped/Config.in
```kconfig
config BR2_PACKAGE_PYTHON_MOPIDY_MOPED
	bool "python-mopidy-moped"
	depends on BR2_PACKAGE_PYTHON
	depends on BR2_PACKAGE_PYTHON_MOPIDY
	help
		A mopidy extension to providing a slick Web UI
```

## package/python-mopidy/Config.in
```kconfig
config BR2_PACKAGE_PYTHON_MOPIDY
	bool "python-mopidy"
	depends on BR2_PACKAGE_PYTHON
	depends on BR2_PACKAGE_PYTHON_TORNADO
	depends on BR2_PACKAGE_PYTHON_PYKKA
	depends on BR2_PACKAGE_PYTHON_PYGOBJECT
	depends on BR2_PACKAGE_GST_PLUGINS_UGLY_PLUGIN_LAME
	depends on BR2_PACKAGE_GST_PLUGINS_UGLY_PLUGIN_MAD
	depends on BR2_PACKAGE_GST_PLUGINS_GOOD_PLUGIN_PULSE
	help
		Mopidy is an extensible music server written in Python.
```

## package/python-mutagen/Config.in
```kconfig
config BR2_PACKAGE_PYTHON_MUTAGEN
	bool "python-mutagen"
	depends on BR2_PACKAGE_PYTHON
	help
		Mutagen.
```

## package/python-oauth2client/Config.in
```kconfig
config BR2_PACKAGE_PYTHON_OAUTH2CLIENT
	bool "python-oauth2client"
	depends on BR2_PACKAGE_PYTHON
	help
		Oauth2client.
```

## package/python-proboscis/Config.in
```kconfig
config BR2_PACKAGE_PYTHON_PROBOSCIS
	bool "python-proboscis"
	depends on BR2_PACKAGE_PYTHON
	help
		Proboscis.
```

## package/python-pyalsaaudio/Config.in
```kconfig
config BR2_PACKAGE_PYTHON_PYALSAAUDIO
	bool "python-pyalsaaudio"
	depends on BR2_PACKAGE_PYTHON
	depends on BR2_PACKAGE_ALSA_LIB
	help
		This package contains wrappers for accessing the ALSA API from Python. It is fairly complete for PCM devices and Mixer access.
```

## package/python-pykka/Config.in
```kconfig
config BR2_PACKAGE_PYTHON_PYKKA
	bool "python-pykka"
	depends on BR2_PACKAGE_PYTHON
	help
		Pykka is a Python implementation of the actor model
```

## package/python-requests/Config.in
```kconfig
config BR2_PACKAGE_PYTHON_REQUESTS
	bool "python-requests"
	depends on BR2_PACKAGE_PYTHON
	help
		Requests.
```

## package/python-six/Config.in
```kconfig
config BR2_PACKAGE_PYTHON_SIX
	bool "python-six"
	depends on BR2_PACKAGE_PYTHON
	help
		Six.
```

## package/python-validictory/Config.in
```kconfig
config BR2_PACKAGE_PYTHON_VALIDICTORY
	bool "python-validictory"
	depends on BR2_PACKAGE_PYTHON
	help
		validictory.
```

## package/shairport/Config.in
```kconfig
menuconfig BR2_PACKAGE_SHAIRPORT
	bool "shairport"
	select BR2_PACKAGE_OPENSSL
	help
	  This program emulates an AirPort Express for the purpose of streaming music from iTunes and compatible iPods and iPhones. It implements a server for the Apple RAOP protocol. ShairPort does not support AirPlay v2 (video and photo streaming).

	  http://github.com/abrasive/shairport

if BR2_PACKAGE_SHAIRPORT

config BR2_PACKAGE_SHAIRPORT_AVAHI
	bool "avahi"
	depends on !BR2_PREFER_STATIC_LIB # avahi
	select BR2_PACKAGE_AVAHI
	select BR2_PACKAGE_AVAHI_DAEMON
	help
	  Enable Avahi support.

config BR2_PACKAGE_SHAIRPORT_PULSE
	bool "pulseaudio"
	select BR2_PACKAGE_PULSEAUDIO
	help
	  Enable PulseAudio support.

config BR2_PACKAGE_SHAIRPORT_AO
	bool "libao"
	select BR2_PACKAGE_LIBAO
	help
	  Enable libao support

endif
```
